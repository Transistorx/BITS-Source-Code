## esp32-relay-controller/components/mqtt_link/Kconfig
```kconfig
menu "MQTT link (telemetry + operator commands)"

    config MQTT_LINK_BROKER_URI
        string "Broker URI (empty disables MQTT)"
        default "mqtt://192.168.137.1:1883"
        help
            Mosquitto in WSL, same host the devices already reach. The URI is
            logged only with any user:password@ part removed. With MQTT off
            or unreachable the controller keeps using the HTTP routes.

    config MQTT_LINK_DEVICE_ID_OVERRIDE
        string "Device id override (empty = the telemetry device id)"
        default ""
        help
            Topics are cas/{device}/... where {device} is [A-Za-z0-9._-]{1,64}.
            Left empty, the same device id the HTTP telemetry uses is taken, so
            topic and payload device ids always agree.

    config MQTT_LINK_USERNAME
        string "Broker username (empty = anonymous)"
        default ""

    config MQTT_LINK_PASSWORD
        string "Broker password"
        default ""
        help
            Never logged.

    config MQTT_LINK_KEEPALIVE_S
        int "MQTT keepalive (seconds)"
        default 30
        range 5 120

endmenu
```

## esp32-weight-sender/components/board/Kconfig
```kconfig
menu "Weighing-scale board pin map"

    # This menu is owned by the board component so that EVERY project that
    # links board_pins.c (production firmware and the QEMU test suite) sees
    # the same symbols. Do not move these back into main/Kconfig.projbuild:
    # the QEMU project has its own main and never loads the production one.

    choice WEIGHT_DEMO_BOARD_VARIANT
        prompt "Weighing-scale board variant"
        default WEIGHT_DEMO_BOARD_RS485_MAX13487E
        help
            Selects the ONE authoritative pin map compiled into the firmware.
            GPIO and UART-peripheral numbers for the scale interface live in
            components/board/include/board_pins.h and are NOT Kconfig values,
            so they cannot be scattered or set to an invalid combination.

    config WEIGHT_DEMO_BOARD_RS485_MAX13487E
        bool "RS-485 MAX13487E AutoDirection (current board)"
        help
            RS-485 scale interface on MAX13487E auto-direction transceivers.

              CH1: UART1  TX=GPIO13 (VFD_TX)   RX=GPIO15 (VFD_RX, MTDO strap)
              CH2: UART2  TX=GPIO32 (VFD_TX_2) RX=GPIO33 (VFD_RX_2)

            The MAX13487E drives bus direction from its own TX activity, so
            the ESP32 uses an ordinary UART: NO DE/RE GPIO, NO RTS direction
            control, and UART_MODE_RS485_HALF_DUPLEX must not be enabled.
            Differential connector A/B/GND numbering is VERIFY ON PCB.

    config WEIGHT_DEMO_BOARD_RS232_LEGACY
        bool "Legacy RS-232 map (rollback board)"
        help
            Previous RS-232 PCB map, kept selectable in the same commit so the
            RS-232 rollback path stays available.

              CH1: UART1  TX=GPIO33 (232TX1) RX=GPIO35 (232RX1, input-only)
              CH2: UART2  TX=GPIO32 (232TX2) RX=GPIO34 (232RX2, input-only)

    endchoice

    config WEIGHT_DEMO_SCALE_ACTIVE_CHANNEL
        int "Active scale channel for the single physical CAS scale"
        range 1 2
        default 1
        help
            Field deployment is ONE physical CAS CI-150A scale. This selects
            which RS-485 channel carries it. Weight, freshness, link state,
            the health counters, ZERO/TARE and the MQTT publisher all follow
            this channel only; the other channel is still opened and counted
            for diagnostics but can never make the link look healthy.

            The deployed CI-150A is wired to RS-485 CHANNEL 1 (UART1,
            TX=GPIO13, RX=GPIO15), so the default is 1. NVS key "scale_ch"
            (1 or 2; 0 = use this value) overrides it at boot.

            Channel 1 RX is GPIO15 (MTDO), a strapping pad. A receiver that
            drives the bus low during reset can disturb boot; verify on the
            PCB. Do not remap pins to work around it.

endmenu
```

## esp32-weight-sender/components/log_util/Kconfig.projbuild
```kconfig
menu "Serial logging (log_util)"

    # Owned by components/log_util so the production firmware and the QEMU test
    # project (which never loads production main/Kconfig.projbuild) see the
    # same symbols.

    config SCALE_TRACE_FRAMES
        bool "Trace raw scale frames (DEBUG, very verbose)"
        default n
        help
            Logs every assembled RS-485/RS-232 frame at DEBUG on tag RS485. A
            CI-150A streams about 22 frames/s per channel, so this buries the
            monitor. Also requires Component config > Log > Maximum log
            verbosity = Debug, otherwise the DEBUG lines are compiled out.
            Replaces WEIGHT_DEMO_LOG_SCALE_FRAMES, which still works as an alias.

    config MQTT_TRACE_PAYLOADS
        bool "Trace MQTT payloads (DEBUG)"
        default n
        help
            Logs outbound and inbound MQTT topic + payload at DEBUG on tag MQTT.
            Payloads never contain credentials. Needs Maximum log verbosity =
            Debug as well.

    config HEALTH_SUMMARY_PERIOD_S
        int "Health summary period in seconds (0 = off)"
        default 15
        range 0 60
        help
            One compact "SYS: up=.. heap=.. mqtt=.. scale=.." line at this
            period from the low-priority diag task. 0 disables it; otherwise
            use 5..60.

endmenu
```

## esp32-weight-sender/components/mqtt_link/Kconfig
```kconfig
menu "MQTT link (status + remote scale commands)"

    config MQTT_LINK_BROKER_URI
        string "Broker URI (empty disables MQTT)"
        default "mqtt://192.168.137.1:1883"
        help
            Mosquitto in WSL, same host the devices already reach. The URI is
            logged only with any user:password@ part removed.

    config MQTT_LINK_DEVICE_ID_OVERRIDE
        string "Device id override (empty = NVS device_id)"
        default ""
        help
            Topics are cas/{device}/... where {device} is [A-Za-z0-9._-]{1,64}.
            Left empty, the NVS device_id derived from the Wi-Fi MAC is used.

    config MQTT_LINK_USERNAME
        string "Broker username (empty = anonymous)"
        default ""

    config MQTT_LINK_PASSWORD
        string "Broker password"
        default ""
        help
            Never logged.

    config MQTT_LINK_TLS_BUNDLE
        bool "Verify mqtts:// brokers with the ESP certificate bundle"
        default y
        depends on MBEDTLS_CERTIFICATE_BUNDLE
        help
            An mqtts:// URI attaches esp_crt_bundle_attach so the broker
            certificate is verified against the built-in CA bundle. With this
            off, or with MBEDTLS_CERTIFICATE_BUNDLE off, an mqtts:// URI is
            refused at start (reason MQTT_CFG_INVALID); verification is never
            skipped. A private CA needs a bundled PEM, not designed here.

    config MQTT_LINK_WEIGHT_HB_MS
        int "telemetry/weight heartbeat period (ms)"
        default 1000
        range 500 2000
        help
            A telemetry/weight heartbeat is published this often while no new
            CAS frame arrives. Also the stale limit for a queued weight item.

    config MQTT_LINK_KEEPALIVE_S
        int "MQTT keepalive (seconds)"
        default 30
        range 5 120

    config MQTT_LINK_STATUS_PERIOD_MS
        int "telemetry/status publish period (ms)"
        default 5000
        range 1000 8000
        help
            Must stay under the server's 10 s device-online threshold.

endmenu
```

## esp32-weight-sender/components/scale_hal/Kconfig
```kconfig
menu "Scale reader safety policy"

    # Owned by scale_hal so production firmware and the QEMU test project see
    # the same symbols.

    choice SCALE_PROTOCOL
        prompt "Scale protocol"
        default SCALE_PROTOCOL_CI2001
        help
            The weight source feeding the dispensing brain must decode ONE
            protocol only. Auto-detection makes any stray line that happens to
            parse (including the tail of a truncated frame) publishable as a
            weight, so it is not part of the production configuration.

        config SCALE_PROTOCOL_CI2001
            bool "CAS CI-2001 / CI-150A only (production)"
            help
                Only cas_ci2001_protocol is registered. No auto-detection, no
                generic ASCII fallback, no other parser is compiled in.

        config SCALE_PROTOCOL_AUTODETECT_LEGACY
            bool "Legacy auto-detect over all parsers (tests / bench only)"
            help
                Compiles asuki, asuki-k1, flintec, cas and the generic ASCII
                fallback and lets the application opt in at run time. Used by
                the QEMU suite. NOT for a dispensing weight source.
    endchoice

    config SCALE_ALLOW_GENERIC_FALLBACK
        bool "Legacy: also use the generic ASCII fallback parser"
        depends on SCALE_PROTOCOL_AUTODETECT_LEGACY
        default n

    config SCALE_CI2001_STRICT_PAD
        bool "Reject CI-150A frames whose pad byte (byte 17) differs from the expected value"
        default n
        help
            The CI-150A manual shows byte 17 but this repository holds no
            documented value for it. Leave OFF until the value has been read
            from the bench RAW CAPTURE log line (pad=0x..) of a healthy scale.

    config SCALE_CI2001_PAD_VALUE
        int "Expected pad byte value (0..255)"
        depends on SCALE_CI2001_STRICT_PAD
        range 0 255
        default 0
        help
            Set from the captured bench value; 0 is only a placeholder.

    config SCALE_READER_STALL_GAP_MS
        int "Reader stall threshold (ms)"
        default 250
        range 50 2000
        help
            If the reader task did not run for longer than this, bytes in the
            RX ring were time-stamped late. The ring is flushed and the
            assembler discards up to the next terminator (fail-safe).

    config SCALE_RAW_CAPTURE_PERIOD_MS
        int "RAW CAPTURE log period for the selected channel (ms)"
        default 15000
        range 5000 120000

endmenu
```

## esp32-weight-sender/components/task_hb/Kconfig
```kconfig
menu "Task heartbeats (application supervision)"

    config TASK_HB_FROZEN_MS
        int "Heartbeat frozen threshold (ms)"
        default 10000
        range 2000 60000
        help
            A task heartbeat counter that does not change for this long is
            logged as a fault with reason code HB_FROZEN_<task>.

    config TASK_HB_LINK_RESTART_MS
        int "mqtt_pub frozen threshold for a link restart (ms)"
        default 30000
        range 10000 300000
        help
            A frozen mqtt_pub heartbeat for this long triggers
            mqtt_link_stop/start (reason HB_LINK_RESTART_MQTT_PUB).

    config TASK_HB_RESTART_WINDOW_MS
        int "Window for escalating to esp_restart (ms)"
        default 600000
        range 60000 3600000
        help
            A second frozen mqtt_pub heartbeat within this window after a
            link restart triggers a logged esp_restart (reason
            HB_RESTART_MQTT_PUB). Non-safety auto-recovery with a cap.

    config TASK_HB_REBOOT_CAP
        int "Heartbeat reboots allowed before degraded mode"
        default 3
        range 0 10
        help
            Number of HB_RESTART_MQTT_PUB reboots tolerated within one
            stable-uptime period. The count lives in RTC_NOINIT memory so it
            survives esp_restart without NVS wear and is cleared by a power
            cycle or an invalid record. Once reached the device stays up in
            degraded mode (link restarts only, status hb_degraded=1).

    config TASK_HB_REBOOT_STABLE_MS
        int "Uptime after which the reboot counter is cleared (ms)"
        default 3600000
        range 60000 86400000
        help
            Running this long without a heartbeat reboot clears the reboot
            counter and the degraded flag.

endmenu
```
